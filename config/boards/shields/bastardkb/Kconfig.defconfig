## config/boards/shields/bastardkb/Kconfig.defconfig
```kconfig
if SHIELD_BASTARDKB_LEFT
# if SHIELD_BASTARDKB_RIGHT
config ZMK_KEYBOARD_NAME
    default "charybdis"

config ZMK_SPLIT_ROLE_CENTRAL
    default y

config ZMK_USB
	default y

config ZMK_POINTING
    default y

config SPI
    default y
endif

if SHIELD_BASTARDKB_LEFT || SHIELD_BASTARDKB_RIGHT

config ZMK_SPLIT
    default y

endif
```
